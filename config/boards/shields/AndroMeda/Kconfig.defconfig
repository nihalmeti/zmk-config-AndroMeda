## config/boards/shields/AndroMeda/Kconfig.defconfig
```kconfig
if SHIELD_ANDROMEDA

config ZMK_KEYBOARD_NAME
    default "AndroMeda"
    

config LED
    default y

config LED_LOCK_STATUS
    bool "Enable LED lock indicators, such as Caps lock, Num Lock ...."
    default n


# Add these lines for Bongo Cat
config LV_USE_ANIMATION
    bool
    default y

config ZMK_WIDGET_BONGO_CAT
    bool
    default y
    select LV_USE_IMG
    select LV_USE_ANIMATION
    
config LV_Z_VDB_SIZE
    default 100

config LV_DPI_DEF
    default 161

config LV_Z_BITS_PER_PIXEL
    default 1

choice LV_COLOR_DEPTH
    default LV_COLOR_DEPTH_1
endchoice

config LV_USE_LABEL
    default y
    
choice ZMK_DISPLAY_WORK_QUEUE
    default ZMK_DISPLAY_WORK_QUEUE_DEDICATED
endchoice

choice ZMK_DISPLAY_STATUS_SCREEN
    default ZMK_DISPLAY_STATUS_SCREEN_CUSTOM
endchoice

config ZMK_DISPLAY_STATUS_SCREEN_BUILT_IN
    select LV_FONT_MONTSERRAT_26

endif 
```

## config/west.yml
```yaml
# manifest:
#   remotes:
#     - name: zmkfirmware
#       url-base: https://github.com/zmkfirmware
#     - name: nihalmeti
#       url-base: https://github.com/nihalmeti
#     # Additional modules containing boards/shields/custom code can be listed here as well
#     # See https://docs.zephyrproject.org/3.2.0/develop/west/manifest.html#projects
#   projects:
#     - name: zmk
#       remote: zmkfirmware
#       revision: main
#       import: app/west.yml 
#     - name: nice-view-gem #new entry
#       remote: nihalmeti #new entry
#       revision: main #new entry
#   self:
#     path: config
manifest:
  remotes:
    - name: SamIAm2000
      url-base: https://github.com/SamIAm2000
  projects:
    - name: zmk
      remote: SamIAm2000
      revision: bongo-cat-dedicated-work-queue
      import: app/west.yml
  self:
    path: config
```
